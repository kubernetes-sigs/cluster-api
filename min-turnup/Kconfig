## min-turnup/Kconfig
```kconfig
mainmenu "Kubernetes Minimal Turnup Configuration"

source "phase1/Kconfig"
source "phase1b/Kconfig"
source "phase2/Kconfig"
source "phase3/Kconfig"
```

## min-turnup/phase1/Kconfig
```kconfig
menu "Phase 1: Cluster Resource Provisioning"

config phase1.num_nodes
	int "number of nodes"
	default 4
	range 1 1000
	help
	  The number of nodes you would like to provision.

config phase1.instance_prefix
	string "instance prefix"
	default "kuberentes"
	help
	  A prefix to append to all instance names.

menuconfig phase1.cloud_provider
	string "cloud proivder"
	default "gce"
	help
	  The cloud provider you would like to deploy to.

	  Valid options are (gce).

if phase1.cloud_provider = "gce"
	source "phase1/gce/Kconfig"
endif

endmenu
```

## min-turnup/phase1/gce/Kconfig
```kconfig
menu "GCE configuration"

config phase1.gce.os_image
	string "OS image for nodes"
	default "ubuntu-1604-xenial-v20160420c"
	help
	  The OS image you would like to use.

config phase1.gce.instance_type
	string "instance type"
	default "n1-standard-2"
	help
	  The instance type to use.

config phase1.gce.project
	string "GCP project"
	help
	  The GCP project to use.

config phase1.gce.region
	string "region"
	default "us-central1"
	help
	  The GCP region to use.

config phase1.gce.zone
	string "zone"
	default "us-central1-b"
	help
	  The GCP zone to use. Must be in the previously specified region.

config phase1.gce.network
	string "network"

endmenu
```

## min-turnup/phase1b/Kconfig
```kconfig
menu "Phase 1b: Cryptographic Asset Provisioning"

config phase1b.extra_api_sans
	string "Extra SANs"
	help
	  A comma seperated list of IPs that should be included as
	  Subject Alternative Names in the apiservers x509 certificate.

config phase1b.extra_api_dns_names
	string "Extra DNS names"
	help
	  A comma seperated list of DNS names that should be included as
	  Subject Alternative Names in the apiservers x509 certificate.
endmenu
```

## min-turnup/phase2/Kconfig
```kconfig
menu "Phase 2: Node Bootstrapping"

config phase2.docker_registry
	string "docker registry"
	default "gcr.io/google-containers"
	help
	  The docker registry to pull cluster components from.

config phase2.kubernetes_version
	string "kubernetes version"
	default "v1.2.4"
	help
	  The version of Kubernetes to deploy.

endmenu
```

## min-turnup/phase3/Kconfig
```kconfig
menu "Phase 3: Deploying Addons"

config phase3.run_addons
	bool "Run the addon manager?"
	default y
	help
	  Should we deploy the addon manager?

if phase3.run_addons

config phase3.kube_proxy
	bool "Run kube-proxy?"
	default y
	help
	  Should we deploy the kube-proxy to nodes?

config phase3.dashboard
	bool "Run the dashboard?"
	default y
	help
	  Should we deploy the kubernetes dashboard?

config phase3.kube_dns
	bool "Run kube-dns?"
	default y
	help
	  Should we deploy kube-dns?

config phase3.elasticsearch
	bool "Run elasticsearch?"
	default y
	help
	  Should we deploy elasticsearch?

endif

endmenu
```
